## package/apptainer/Config.in
```kconfig
config BR2_PACKAGE_APPTAINER
	bool "apptainer"
	depends on BR2_PACKAGE_HOST_GO_TARGET_ARCH_SUPPORTS
	depends on BR2_PACKAGE_HOST_GO_TARGET_CGO_LINKING_SUPPORTS
	depends on BR2_PACKAGE_LIBSECCOMP
	depends on BR2_PACKAGE_CA_CERTIFICATES
	depends on BR2_PACKAGE_OPENSSL
	depends on BR2_TARGET_TZ_INFO
	depends on BR2_PACKAGE_UTIL_LINUX
	depends on BR2_PACKAGE_UTIL_LINUX_LIBUUID
	depends on BR2_PACKAGE_SQUASHFS
	depends on BR2_BINUTILS_ENABLE_LTO
	depends on BR2_GCC_ENABLE_LTO
	help
          Apptainer: Application containers for Linux
          https://github.com/apptainer/apptainer

if BR2_PACKAGE_APPTAINER

config BR2_PACKAGE_APPTAINER_SINGULARITY_SYMLINK
	bool "install /usr/bin/singularity -> /usr/bin/apptainer symlink"
	depends on !BR2_PACKAGE_SINGULARITY
	help
	  Ensure backwards compatibility with Singularity by creating a symlink.

endif

comment "apptainer cannot be cross-compiled to the selected arch"
	depends on !BR2_PACKAGE_HOST_GO_TARGET_ARCH_SUPPORTS || !BR2_PACKAGE_HOST_GO_TARGET_CGO_LINKING_SUPPORTS

comment "apptainer needs gcc and binutils with LTO"
	depends on !BR2_BINUTILS_ENABLE_LTO || !BR2_GCC_ENABLE_LTO

comment "apptainer needs libseccomp, ca-certificates, tzinfo, squashfs, openssl and libuuid"
	depends on !BR2_PACKAGE_LIBSECCOMP || \
		!BR2_PACKAGE_CA_CERTIFICATES || \
		!BR2_TARGET_TZ_INFO || \
		!BR2_PACKAGE_SQUASHFS || \
		!BR2_PACKAGE_OPENSSL || \
		!BR2_PACKAGE_UTIL_LINUX || \
		!BR2_PACKAGE_UTIL_LINUX_LIBUUID
```

## package/bash-static/Config.in
```kconfig
config BR2_PACKAGE_BASH_STATIC
    bool "bash-static"
    help
        statically compiled bash shell
```

## package/libglvnd/Config.in
```kconfig
config BR2_PACKAGE_LIBGLVND
    bool "libglvnd"
    select BR2_PACKAGE_XLIB_LIBXEXT
    select BR2_PACKAGE_XLIB_LIBX11
    select BR2_PACKAGE_XLIB_XORGPROTO
    help
        The GL Vendor-Neutral Dispatch library

        libglvnd is a vendor-neutral dispatch layer for arbitrating OpenGL API 
        calls between multiple vendors. It allows multiple drivers from 
        different vendors to coexist on the same filesystem, and determines
        which vendor to dispatch each API call to at runtime.

        Both GLX and EGL are supported, in any combination with OpenGL and
        OpenGL ES.

if BR2_PACKAGE_LIBGLVND

config BR2_PACKAGE_PROVIDES_LIBGL
    default "libglvnd"

config BR2_PACKAGE_PROVIDES_LIBGLES
    default "libglvnd"

config BR2_PACKAGE_PROVIDES_LIBEGL
    default "libglvnd"

endif
```

## package/libnvidia-container/Config.in
```kconfig
config BR2_PACKAGE_LIBNVIDIA_CONTAINER
    bool "libnvidia-container"
    depends on BR2_PACKAGE_LIBCAP
    depends on BR2_PACKAGE_NVIDIA_DRIVER
    help
        NVIDIA libnvidia-container
        https://github.com/NVIDIA/libnvidia-container
```

## package/python-plotext/Config.in
```kconfig
config BR2_PACKAGE_PYTHON_PLOTEXT
	bool "python-plotext"
	help
	  plotext plots directly on terminal.

	  https://github.com/piccolomo/plotext
```

## package/python-servis/Config.in
```kconfig
config BR2_PACKAGE_PYTHON_SERVIS
	bool "python-servis"
	select BR2_PACKAGE_PYTHON_PLOTEXT
	help
	  A tool for rendering time series plots in multiple formats.
```

## package/qemu-efi-aarch64/Config.in
```kconfig
config BR2_PACKAGE_QEMU_EFI_AARCH64
	bool "qemu_efi_aarch64"
	depends on BR2_x86_64 || BR2_aarch64
	depends on BR2_TOOLCHAIN_GCC_AT_LEAST_5
```

## package/riscv-coremark/Config.in
```kconfig
config BR2_PACKAGE_RISCV_COREMARK
	bool "riscv-coremark"
	depends on BR2_RISCV_64 
	help
	  Test riscv-coremark
```

## package/sargraph/Config.in
```kconfig
config BR2_PACKAGE_SARGRAPH
	bool "sargraph"
	select BR2_PACKAGE_GNUPLOT
	select BR2_PACKAGE_PYTHON3
	select BR2_PACKAGE_SCREEN
	select BR2_PACKAGE_PYTHON_SERVIS
	
	help
	  This is a simple python tool that uses "sysstat" ("sar") and "gnuplot" to plot cpu and ram usage.
```

## package/singularity/Config.in
```kconfig
config BR2_PACKAGE_SINGULARITY
	bool "singularity"
	depends on BR2_PACKAGE_HOST_GO_TARGET_ARCH_SUPPORTS
	depends on BR2_PACKAGE_HOST_GO_TARGET_CGO_LINKING_SUPPORTS
	depends on BR2_PACKAGE_LIBSECCOMP
	depends on BR2_PACKAGE_CA_CERTIFICATES
	depends on BR2_PACKAGE_OPENSSL
	depends on BR2_TARGET_TZ_INFO
	depends on BR2_PACKAGE_UTIL_LINUX
	depends on BR2_PACKAGE_UTIL_LINUX_LIBUUID
	depends on BR2_PACKAGE_SQUASHFS
	depends on BR2_BINUTILS_ENABLE_LTO
	depends on BR2_GCC_ENABLE_LTO
	help
          Sylabs Singularity container
          https://github.com/sylabs/singularity

comment "singularity cannot be cross-compiled to the selected arch"
	depends on !BR2_PACKAGE_HOST_GO_TARGET_ARCH_SUPPORTS || !BR2_PACKAGE_HOST_GO_TARGET_CGO_LINKING_SUPPORTS

comment "singularity needs gcc and binutils with LTO"
	depends on !BR2_BINUTILS_ENABLE_LTO || !BR2_GCC_ENABLE_LTO

comment "singularity needs libseccomp, ca-certificates, tzinfo, squashfs, openssl and libuuid"
	depends on !BR2_PACKAGE_LIBSECCOMP || \
		!BR2_PACKAGE_CA_CERTIFICATES || \
		!BR2_TARGET_TZ_INFO || \
		!BR2_PACKAGE_SQUASHFS || \
		!BR2_PACKAGE_OPENSSL || \
		!BR2_PACKAGE_UTIL_LINUX || \
		!BR2_PACKAGE_UTIL_LINUX_LIBUUID
```

## package/tui-selector/Config.in
```kconfig
config BR2_PACKAGE_TUI_SELECTOR
    bool "tui-selector"
    select BR2_PACKAGE_NCURSES
    help
        The TUI menu for selecting executables based on rules files
```

## package/virglrenderer/Config.in
```kconfig
config BR2_PACKAGE_VIRGLRENDERER
	bool "virglrenderer"
	help
		Virgil is a research project to investigate the possibility of creating a virtual 3D GPU 
		for use inside qemu virtual machines, that allows the guest operating system to 
		use the capabilities of the host GPU to accelerate 3D rendering. 
		The plan is to have a guest GPU that is fully independent of the host GPU.
	depends on BR2_PACKAGE_LIBEPOXY
	depends on BR2_PACKAGE_HOST_PKGCONF
```
